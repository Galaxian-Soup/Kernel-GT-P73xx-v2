## drivers/net/wireless/bcmdhd/Kconfig
```kconfig
config BCMDHD
	tristate "Broadcom 4329/30 wireless cards support"
	depends on MMC
	---help---
	  This module adds support for wireless adapters based on
	  Broadcom 4329/30 chipset.

	  This driver uses the kernel's wireless extensions subsystem.

	  If you choose to build a module, it'll be called dhd. Say M if
	  unsure.

config BCMDHD_FW_PATH
	depends on BCMDHD
	string "Firmware path"
	default "/system/etc/firmware/fw_bcmdhd.bin"
	---help---
	  Path to the firmware file.

config BCMDHD_NVRAM_PATH
	depends on BCMDHD
	string "NVRAM path"
	default "/system/etc/wifi/bcmdhd.cal"
	---help---
	  Path to the calibration file.

config BCMDHD_WEXT
	bool "Enable WEXT support"
	depends on BCMDHD && CFG80211 = n
	select WIRELESS_EXT
	select WEXT_PRIV
	help
	  Enables WEXT support

config BCMDHD_WIFI_CONTROL_FUNC
        bool "Use bcmdhd_wlan device"
        depends on BCMDHD
        default n
        ---help---
          Use this option to get various parameters from architecture specific
          bcmdhd_wlan platform device. Say n if unsure.

config BCMDHD_HW_OOB
        bool "Use out of band interrupt"
        depends on BCMDHD
        default n
        ---help---
          Use out of band interrupt for card interrupt and wake on wireless.

config DHD_USE_STATIC_BUF
	bool "Enable memory preallocation"
	depends on BCMDHD
	default n
	---help---
	  Use memory preallocated in platform

 config BCMDHD_BCM4330B1_FW
        bool "Use this when using B1 firmware"
        depends on BCMDHD
        default n
        ---help---
          Use this when using B1 firmware

config DHD_USE_SCHED_SCAN
	bool "Use CFG80211 sched scan"
	depends on BCMDHD && CFG80211
	default n
	---help---
	  Use CFG80211 sched scan
```
